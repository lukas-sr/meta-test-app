## conf/layer.conf
```bitbake
# We have a conf and classes directory, add to BBPATH
BBPATH .= ":${LAYERDIR}"

# We have recipes-* directories, add to BBFILES
BBFILES += "${LAYERDIR}/recipes-*/*/*.bb \
            ${LAYERDIR}/recipes-*/*/*.bbappend"

BBFILE_COLLECTIONS += "meta-lukas-rosa"
BBFILE_PATTERN_meta-lukas-rosa = "^${LAYERDIR}/"
BBFILE_PRIORITY_meta-lukas-rosa = "6"

LAYERDEPENDS_meta-lukas-rosa = "core"
LAYERSERIES_COMPAT_meta-lukas-rosa = "dunfell"
```
